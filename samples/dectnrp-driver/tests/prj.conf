## CMakeLists.txt
```
# Copyright (c) 2026 Codium Electronique
# SPDX-License-Identifier: Apache-2.0

cmake_minimum_required(VERSION 3.20.0)
find_package(Zephyr REQUIRED HINTS $ENV{ZEPHYR_BASE})
project(dectnrp_driver_frame)

target_include_directories(app PRIVATE ../src)
target_sources(app PRIVATE
    src/test_frame.c
    src/test_sensor_payload.c
    ../src/dectnrp_mac_helper.c
    ../src/sensor_payload.c
)
```

## prj.conf
```kconfig
# Copyright (c) 2026 Codium Electronique
# SPDX-License-Identifier: Apache-2.0

CONFIG_ZTEST=y
CONFIG_NETWORKING=y
CONFIG_NET_L2_DUMMY=y
```

## src/test_frame.c
```c
/*
 * Copyright (c) 2026 Codium Electronique
 * SPDX-License-Identifier: Apache-2.0
 */

/**
 * @file
 * @brief Tests of the dectnrp-driver sample frame builder.
 */

#include <errno.h>
#include <string.h>
#include <zephyr/ztest.h>

#include "dectnrp_mac_helper.h"

/* The sample's previous fixed frame, the oracle for the default payload. */
static const uint8_t expected[SAMPLE_FRAME_SIZE] = {
	/* PHY header */
	0x10, 0x78, 0xee, 0xff, 0x71, 0xff, 0xff, 0x00, 0x00, 0x00,
	/* MAC header type, MAC data header */
	0x00, 0x00, 0x17,
	/* MAC mux header: User Flow 1 IE, 13 bytes payload */
	0x43, 0x0d,
	/* Hello World!\n */
	0x48, 0x65, 0x6c, 0x6c, 0x6f, 0x20, 0x57, 0x6f, 0x72, 0x6c, 0x64, 0x21, 0x0a,
	/* MAC mux header: Padding IE, 17 bytes, then the padding */
	0x40, 0x11, 0x00, 0x00, 0x00, 0x00, 0x00, 0x00, 0x00, 0x00, 0x00, 0x00, 0x00, 0x00, 0x00,
	0x00, 0x00};

static uint8_t payload[SAMPLE_FRAME_PAYLOAD_MAX + 1];
static uint8_t frame[SAMPLE_FRAME_SIZE];

static void *setup(void)
{
	for (size_t i = 0; i < sizeof(payload); i++) {
		payload[i] = (uint8_t)(0xa0 + i);
	}
	return NULL;
}

static void before(void *fixture)
{
	ARG_UNUSED(fixture);
	memset(frame, 0xee, sizeof(frame));
}

ZTEST_SUITE(frame, NULL, setup, before, NULL, NULL);

ZTEST(frame, test_build_default)
{
	int ret;

	ret = sample_frame_build(frame, sizeof(frame), sample_frame_default_payload,
				 sample_frame_default_payload_size);
	zassert_equal(ret, SAMPLE_FRAME_SIZE);
	zassert_equal(sample_frame_default_payload_size, 13);
	zassert_mem_equal(frame, expected, sizeof(expected));
}

ZTEST(frame, test_build_padding_boundaries)
{
	int ret;

	ret = sample_frame_build(frame, sizeof(frame), payload, 32);
	zassert_equal(ret, SAMPLE_FRAME_SIZE);
	zassert_equal(frame[13], 0x43);
	zassert_equal(frame[14], 32);
	zassert_mem_equal(&frame[15], payload, 32);

	ret = sample_frame_build(frame, sizeof(frame), payload, 31);
	zassert_equal(ret, SAMPLE_FRAME_SIZE);
	zassert_equal(frame[14], 31);
	zassert_mem_equal(&frame[15], payload, 31);
	zassert_equal(frame[46], 0xC0);

	ret = sample_frame_build(frame, sizeof(frame), payload, 30);
	zassert_equal(ret, SAMPLE_FRAME_SIZE);
	zassert_equal(frame[45], 0xE0);
	zassert_equal(frame[46], 0x00);

	ret = sample_frame_build(frame, sizeof(frame), payload, 29);
	zassert_equal(ret, SAMPLE_FRAME_SIZE);
	zassert_equal(frame[44], 0x40);
	zassert_equal(frame[45], 0x01);
	zassert_equal(frame[46], 0x00);
}

ZTEST(frame, test_build_empty)
{
	static const uint8_t mux[] = {0x43, 0x00, 0x40, 0x1e};
	int ret;

	ret = sample_frame_build(frame, sizeof(frame), NULL, 0);
	zassert_equal(ret, SAMPLE_FRAME_SIZE);
	zassert_mem_equal(&frame[13], mux, sizeof(mux));
	for (size_t i = 17; i < SAMPLE_FRAME_SIZE; i++) {
		zassert_equal(frame[i], 0x00, "byte %zu", i);
	}
}

ZTEST(frame, test_build_rejects)
{
	int ret;

	ret = sample_frame_build(frame, sizeof(frame), payload, 33);
	zassert_equal(ret, -EINVAL);

	ret = sample_frame_build(frame, SAMPLE_FRAME_SIZE - 1, payload, 13);
	zassert_equal(ret, -EINVAL);

	ret = sample_frame_build(frame, sizeof(frame), NULL, 1);
	zassert_equal(ret, -EINVAL);
}
```

## src/test_sensor_payload.c
```c
/*
 * Copyright (c) 2026 Codium Electronique
 * SPDX-License-Identifier: Apache-2.0
 */

/**
 * @file
 * @brief Tests of the dectnrp-driver sample sensor payload record.
 */

#include <string.h>
#include <zephyr/ztest.h>

#include "sensor_payload.h"

/* Shared test vector, the Rust decoder (nrp-ping sensors.rs) checks the same bytes. */
static const uint8_t vector[SENSOR_PAYLOAD_SIZE] = {
	0xc0, 0xde, 0x01, 0x0f, 0x29, 0x09, 0x18, 0x10, 0x0c, 0x00, 0xde, 0xff, 0xeb, 0x03,
	0xd2, 0x00, 0x6a, 0xff, 0x5c, 0xfe, 0x48, 0x0f, 0x41, 0x09, 0x00, 0xf5, 0x00, 0x01};

static struct sensor_payload_values values;
static uint8_t payload[SENSOR_PAYLOAD_SIZE];

static void before(void *fixture)
{
	ARG_UNUSED(fixture);
	memset(&values, 0, sizeof(values));
	values.flags = SENSOR_PAYLOAD_CLIMATE | SENSOR_PAYLOAD_ACCEL | SENSOR_PAYLOAD_MAGN |
		       SENSOR_PAYLOAD_BATTERY;
	values.temperature_centi_c = 2345;
	values.humidity_centi_pct = 4120;
	values.accel_mg[0] = 12;
	values.accel_mg[1] = -34;
	values.accel_mg[2] = 1003;
	values.magn_mgauss[0] = 210;
	values.magn_mgauss[1] = -150;
	values.magn_mgauss[2] = -420;
	values.battery_mv = 3912;
	values.battery_pct = 65;
	values.charger_status = 0x09;
	values.charger_error = 0x00;
	values.battery_ma = 245;
	values.vbus_status = 0x01;
	memset(payload, 0xee, sizeof(payload));
}

ZTEST_SUITE(sensor_payload, NULL, NULL, before, NULL, NULL);

ZTEST(sensor_payload, test_pack_vector)
{
	int diff;

	sensor_payload_pack(&values, payload);
	diff = memcmp(payload, vector, sizeof(vector));
	zassert_equal(diff, 0, "payload differs from the shared vector");
}

ZTEST(sensor_payload, test_pack_partial_flags)
{
	uint8_t zeros[SENSOR_PAYLOAD_SIZE] = {0};
	int diff;

	/* Only the battery group valid: bytes 4-19 are zero, 20-27 are the vector's. */
	values.flags = SENSOR_PAYLOAD_BATTERY;
	sensor_payload_pack(&values, payload);
	zassert_equal(payload[0], SENSOR_PAYLOAD_MAGIC0);
	zassert_equal(payload[1], SENSOR_PAYLOAD_MAGIC1);
	zassert_equal(payload[2], SENSOR_PAYLOAD_VERSION);
	zassert_equal(payload[3], SENSOR_PAYLOAD_BATTERY);
	diff = memcmp(&payload[4], zeros, 16);
	zassert_equal(diff, 0, "invalid groups are not zero");
	diff = memcmp(&payload[20], &vector[20], 8);
	zassert_equal(diff, 0, "battery group differs");

	/* No group valid: everything after the flags is zero. */
	values.flags = 0;
	memset(payload, 0xee, sizeof(payload));
	sensor_payload_pack(&values, payload);
	zassert_equal(payload[0], SENSOR_PAYLOAD_MAGIC0);
	zassert_equal(payload[1], SENSOR_PAYLOAD_MAGIC1);
	zassert_equal(payload[2], SENSOR_PAYLOAD_VERSION);
	zassert_equal(payload[3], 0);
	diff = memcmp(&payload[4], zeros, 24);
	zassert_equal(diff, 0, "payload is not zero");
}

ZTEST(sensor_payload, test_battery_pct)
{
	uint8_t pct;

	pct = sensor_payload_battery_pct(3200);
	zassert_equal(pct, 0);
	pct = sensor_payload_battery_pct(3270);
	zassert_equal(pct, 0);
	pct = sensor_payload_battery_pct(4020);
	zassert_equal(pct, 80);
	pct = sensor_payload_battery_pct(4200);
	zassert_equal(pct, 100);
	pct = sensor_payload_battery_pct(4300);
	zassert_equal(pct, 100);
	/* Halfway between 3840 (50) and 3870 (60). */
	pct = sensor_payload_battery_pct(3855);
	zassert_equal(pct, 55);
	/* Halfway between 3690 (10) and 3730 (20). */
	pct = sensor_payload_battery_pct(3710);
	zassert_equal(pct, 15);
	/* 65.25 truncated, the level of the shared vector. */
	pct = sensor_payload_battery_pct(3912);
	zassert_equal(pct, 65);
}

ZTEST(sensor_payload, test_clamp_i16)
{
	int16_t value;

	value = sensor_payload_clamp_i16(40000);
	zassert_equal(value, 32767);
	value = sensor_payload_clamp_i16(-40000);
	zassert_equal(value, -32768);
	value = sensor_payload_clamp_i16(-5);
	zassert_equal(value, -5);
	value = sensor_payload_clamp_i16(INT64_MAX);
	zassert_equal(value, 32767);
	value = sensor_payload_clamp_i16(INT64_MIN);
	zassert_equal(value, -32768);
	value = sensor_payload_clamp_i16((int64_t)1 << 32);
	zassert_equal(value, 32767);
	value = sensor_payload_clamp_i16(-((int64_t)1 << 32));
	zassert_equal(value, -32768);
}

ZTEST(sensor_payload, test_clamp_u16)
{
	uint16_t value;

	value = sensor_payload_clamp_u16(-1);
	zassert_equal(value, 0);
	value = sensor_payload_clamp_u16(70000);
	zassert_equal(value, 65535);
	value = sensor_payload_clamp_u16(INT64_MAX);
	zassert_equal(value, 65535);
	value = sensor_payload_clamp_u16(INT64_MIN);
	zassert_equal(value, 0);
	value = sensor_payload_clamp_u16((int64_t)1 << 32);
	zassert_equal(value, 65535);
}
```
