/*
 * Copyright (c) 2025 Codium Electronique
 * SPDX-License-Identifier: Apache-2.0
 */

/ {
	chosen {
		zephyr,sram = &sram0_s;
		zephyr,code-partition = &boot_partition;
	};
};

&mx25r1635f {
	status = "okay";
};
