## samples/dectnrp-driver/Kconfig
```kconfig
# Copyright (c) 2026 Codium Electronique
# SPDX-License-Identifier: Apache-2.0

module = SAMPLE_DRIVER_DECTNRP
module-str = Opener DECT NR+ driver sample
source "$(ZEPHYR_BASE)/subsys/logging/Kconfig.template.log_config"

menu "Zephyr Kernel"
source "Kconfig.zephyr"
endmenu

config DECTNRP_SAMPLE_NETWORK_ID
	hex "DECTNRP Network ID"
	default 0x32545279
	range 0x0 0xffffffff
	help
	  The Network ID of the network this radio device belongs to. Override it
	  at build time with -DCONFIG_DECTNRP_SAMPLE_NETWORK_ID=0x12345678. Every
	  device of the network, and the host tools (--network-id or
	  NRP_NETWORK_ID), must use the same value.

config DECTNRP_SAMPLE_LONG_DEVICE_ID
	hex "Long device address"
	default 0x55667788
	range 0x1 0xfffffffd
	help
	  Long device id of device 1.

config DECTNRP_SAMPLE_LONG_ADDR
	hex "DECTNRP Network ID"
	default 0x32545279
	range 0x0 0xffffffff
	help
	  The default Network ID of the network this radio device should belong to.
	  When NET_CONFIG_DECTNRP_NETWORK_ID==0x0 is configured then no Network ID is choosen 
	  per default.


config DECTNRP_SAMPLE_CHANNEL
	int "DECTNRP sample default channel"
	default 1677
	range 0 65535
	help
	  The channel (carrier number) used by the sample application. 1677 is
	  the last channel of band 1. Override it at build time with
	  -DCONFIG_DECTNRP_SAMPLE_CHANNEL=1665. Every device of the network, and
	  the host tools (--channel or NRP_CHANNEL), must use the same value.

config DECTNRP_SAMPLE_PERIOD
	int "RX period"
	default 5000
	help
	   The length of the receive window time in milliseconds.

config DECTNRP_SAMPLE_SENSOR_PAYLOAD
	bool "Send sensor readings instead of Hello World"
	depends on SENSOR
	help
	  Read the SHT4x, LSM6DSL (with a LIS2MDL on its sensor hub) and
	  nPM13xx charger found in the devicetree before each cycle, and send
	  them as the 28-byte sensor record described in README.rst.
```
